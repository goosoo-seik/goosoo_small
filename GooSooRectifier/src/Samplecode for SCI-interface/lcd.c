/*******************************************************************************
********************************************************************************
**
** File Name
** ---------
**
** LCD.C
**
********************************************************************************
********************************************************************************
**
** Description
** -----------
** This file contains functions for accessing the LCD on the AnyBus EVB
**
**
**
********************************************************************************
********************************************************************************
**                                                                            **
** COPYRIGHT NOTIFICATION (c) 1995,96,97,98,99 HMS Industrial Networks AB.    **
**                                                                            **
** This program is the property of HMS Industrial Networks AB.                **
** It may not be reproduced, distributed, or used without permission          **
** of an authorised company official.                                         **
**                                                                            **
********************************************************************************
********************************************************************************
**
** Company: HMS Industrial Networks AB
**          Pilefeltsgatan 93-95
**          S-302 50  Halmstad
**          SWEDEN
**          Tel:     +46 (0)35 - 17 29 00
**          Fax:     +46 (0)35 - 17 29 09
**          e-mail:  info@hms.se
**
********************************************************************************
********************************************************************************
*/

/*******************************************************************************
********************************************************************************
**
** Change Log
** ----------
**
** Latest Revision:
**
**    Rev 0.10    12 jun 2002   Created by AnN
**    Rev 1.00    12 jul 2002   First Release
**
********************************************************************************
********************************************************************************
*/

#include "fd.h"
#include "reg517a.h"
#include <ABSACC.H>


/*******************************************************************************
**
** Public Services
**
********************************************************************************
*/

/*------------------------------------------------------------------------------
** LCD_ClearDisplay()
**------------------------------------------------------------------------------
*/

void LCD_ClearDisplay( void )
{

   UINT16 x,t;

   x = 0;

   XBYTE[ 0xE800 ] = 0xC0;

   for( t = 0 ; t < 100 ; t++ )
   ;

   while(x<16)
   {

      XBYTE[0xE802]=' ';
      x++;

      for( t = 0 ; t < 100 ; t++ )
      ;

   }

}/* end LCD_ClearDisplay */


/*------------------------------------------------------------------------------
** LCD_Init()
**------------------------------------------------------------------------------
*/

void LCD_Init( void )
{

   UINT16 x;

   XBYTE[ 0xE800 ] = 0x38;

   for( x = 0 ; x < 100 ; x++ )
   ;

   XBYTE[ 0xE800 ] = 0x0C;

   for( x = 0 ; x < 100 ; x++ )
   ;

   XBYTE[ 0xE800 ] = 0x06;

   for( x = 0; x < 100 ; x++ )
   ;

   XBYTE[ 0xE800 ] = 0x01;

   for( x = 0 ; x < 100 ; x++ )
   ;

}/* end LCD_Init */


/*------------------------------------------------------------------------------
** LCD_PrintUpper()
**------------------------------------------------------------------------------
*/

void LCD_PrintString( UINT8 *abString )
{

   UINT16 iX, iT;

   iX =0;

   while( ( abString[ iX ] != '\0'  )&& ( iX < 16) )
   {

      XBYTE[0xE802]= abString[ iX ];
      iX++;

      for( iT = 0 ; iT < 100 ; iT++ )
     ;

   }/* end while */

}/* end LCD_PrintUpper */


/*------------------------------------------------------------------------------
** LCD_SelectRow()
**------------------------------------------------------------------------------
*/

void LCD_SelectRow( UINT8 bRow )
{

   UINT16 iT;

   /*
   ** Move to right row
   */

   if( bRow == 0 )
   {

      XBYTE[ 0xE800 ] = 0x80;

   }
   else
   {

      XBYTE[ 0xE800 ] = 0xC0;

   }/* end if */

   for( iT = 0 ; iT < 100 ; iT++ )
   ;

}/* end LCD_SelectRow */


/*------------------------------------------------------------------------------
** LCD_PrintHex()
**------------------------------------------------------------------------------
*/

LCD_PrintHex( UINT8 bValue )
{

   UINT16 iT;
   UINT8 bHighChar, bLowChar;


   bHighChar = ( bValue >> 4 ) & 0x0F;

   if( bHighChar < 10 )
   {

         bHighChar = bHighChar + 0x30;

   }
   else
   {

         bHighChar = bHighChar + 0x37;

   }/* end if */

   XBYTE[ 0xE802 ] = bHighChar;

   for( iT = 0 ; iT < 100 ; iT++)
   ;



   bLowChar = bValue & 0x0F;

   if( bLowChar < 10 )
   {

         bLowChar = bLowChar + 0x30;

   }
   else
   {

         bLowChar = bLowChar + 0x37;

   }/* end if */

   XBYTE[ 0xE802 ] = bLowChar;

   for( iT = 0 ; iT < 100 ; iT++)
   ;

}/* end LCD_PrintHex */


/*******************************************************************************
**
** End of LCD.C
**
********************************************************************************
*/